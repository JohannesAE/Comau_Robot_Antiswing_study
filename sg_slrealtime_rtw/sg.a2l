/******************************************************************************
* ASAP2 file: sg.a2l
* Academic License - for use in teaching, academic research, and meeting
* course requirements at degree granting institutions only. Not for
* government, commercial, or other organizational use.
* Code generation for model "sg".
* Model version : 1.182
* Simulink Coder version : 10.4 R2021b
* C source code generated on : Thu Apr 17 17:12:55 2025
* Target selection: slrealtime.tlc
* Embedded hardware selection: Intel->x86-64 (Linux 64)
* Code generation objectives: Unspecified
* Validation result: Not run
* (add additional file header information here)
******************************************************************************/ ASAP2_VERSION 1 71
/begin PROJECT ProjectName "Project Comment Goes Here"
/begin HEADER "Header Comments go here" /end HEADER
/begin MODULE ModuleName "Module Comment Goes Here"
/begin IF_DATA XCP
 /begin PROTOCOL_LAYER 0x0100 0x03E8 0x00C8 0x0000 0x0000 0x0000 0x0000 0x0000 0xFC 0x0578 BYTE_ORDER_MSB_LAST ADDRESS_GRANULARITY_BYTE OPTIONAL_CMD ALLOC_ODT_ENTRY OPTIONAL_CMD ALLOC_ODT OPTIONAL_CMD ALLOC_DAQ OPTIONAL_CMD FREE_DAQ OPTIONAL_CMD GET_DAQ_CLOCK OPTIONAL_CMD GET_DAQ_RESOLUTION_INFO OPTIONAL_CMD GET_DAQ_PROCESSOR_INFO OPTIONAL_CMD START_STOP_SYNCH OPTIONAL_CMD START_STOP_DAQ_LIST OPTIONAL_CMD SET_DAQ_LIST_MODE OPTIONAL_CMD WRITE_DAQ OPTIONAL_CMD SET_DAQ_PTR OPTIONAL_CMD GET_CAL_PAGE OPTIONAL_CMD SET_CAL_PAGE OPTIONAL_CMD COPY_CAL_PAGE OPTIONAL_CMD SHORT_DOWNLOAD OPTIONAL_CMD DOWNLOAD_MAX OPTIONAL_CMD DOWNLOAD OPTIONAL_CMD SHORT_UPLOAD OPTIONAL_CMD UPLOAD OPTIONAL_CMD SET_MTA OPTIONAL_CMD GET_SEGMENT_INFO OPTIONAL_CMD GET_PAGE_INFO OPTIONAL_CMD SET_SEGMENT_MODE OPTIONAL_CMD GET_SEGMENT_MODE OPTIONAL_CMD GET_PAG_PROCESSOR_INFO OPTIONAL_CMD MODIFY_BITS /end PROTOCOL_LAYER
 /begin DAQ DYNAMIC 0x0000 0x0080 0x00 OPTIMISATION_TYPE_DEFAULT ADDRESS_EXTENSION_FREE IDENTIFICATION_FIELD_TYPE_RELATIVE_WORD_ALIGNED GRANULARITY_ODT_ENTRY_SIZE_DAQ_BYTE 0xFF OVERLOAD_INDICATION_PID PRESCALER_SUPPORTED /begin STIM GRANULARITY_ODT_ENTRY_SIZE_STIM_BYTE 0xFF /end STIM /begin TIMESTAMP_SUPPORTED 0x0001 SIZE_DWORD UNIT_1US TIMESTAMP_FIXED /end TIMESTAMP_SUPPORTED /begin EVENT "1 ms" "1 ms" 0x0000 DAQ 0xFF 0x01 0x06 0x00 /end EVENT /end DAQ
 /begin XCP_ON_UDP_IP 0x0100 0x15B3 ADDRESS "192.168.1.5" /end XCP_ON_UDP_IP
/end IF_DATA
/begin MOD_PAR "MOD PAR Comment Goes Here"
 /begin MEMORY_SEGMENT sg_cal_impl "sg_cal_impl" DATA FLASH INTERN 0x00229020 0x90 -1 -1 -1 -1 -1
  /begin IF_DATA XCP
   /begin SEGMENT 0x00 0x02 0x00 0x00 0x00
    /begin PAGE 0x00 ECU_ACCESS_DONT_CARE XCP_READ_ACCESS_DONT_CARE XCP_WRITE_ACCESS_NOT_ALLOWED /end PAGE
    /begin PAGE 0x01 ECU_ACCESS_DONT_CARE XCP_READ_ACCESS_DONT_CARE XCP_WRITE_ACCESS_DONT_CARE /end PAGE
   /end SEGMENT
  /end IF_DATA
 /end MEMORY_SEGMENT
/end MOD_PAR
/begin MOD_COMMON "Mod Common Comment Here" BYTE_ORDER MSB_LAST ALIGNMENT_BYTE 1 ALIGNMENT_WORD 2 ALIGNMENT_LONG 4 ALIGNMENT_FLOAT32_IEEE 4 ALIGNMENT_FLOAT64_IEEE 8 ALIGNMENT_INT64 8 /end MOD_COMMON
/begin CHARACTERISTIC sg_cal_impl.Constant1_Value "" VALUE 0x00229068 Scalar_FLOAT64_IEEE 0 sg_CM_double -1.7E+308 1.7E+308 /end CHARACTERISTIC
/begin CHARACTERISTIC sg_cal_impl.Constant1_Value_o "" VALUE 0x00229098 Scalar_ULONG 0 sg_CM_uint32 0 2147483646 /end CHARACTERISTIC
/begin CHARACTERISTIC sg_cal_impl.Constant2_Value "" VALUE 0x00229050 Scalar_FLOAT64_IEEE 0 sg_CM_double -1.7E+308 1.7E+308 /end CHARACTERISTIC
/begin CHARACTERISTIC sg_cal_impl.Constant2_Value_b "" VALUE 0x00229090 Scalar_FLOAT32_IEEE 0 sg_CM_single -3.4E+38 3.4E+38 /end CHARACTERISTIC
/begin CHARACTERISTIC sg_cal_impl.Constant_Value "" VALUE 0x00229058 Scalar_FLOAT64_IEEE 0 sg_CM_double -1.7E+308 1.7E+308 /end CHARACTERISTIC
/begin CHARACTERISTIC sg_cal_impl.Constant_Value_i "" VALUE 0x0022908C Scalar_FLOAT32_IEEE 0 sg_CM_single -3.4E+38 3.4E+38 /end CHARACTERISTIC
/begin CHARACTERISTIC sg_cal_impl.Delay_InitialCondition "" VALUE 0x00229094 Scalar_ULONG 0 sg_CM_uint32 0 2147483646 /end CHARACTERISTIC
/begin CHARACTERISTIC sg_cal_impl.Gain_Gain "" VALUE 0x0022909C Scalar_SWORD 0 sg_CM_sfix16_En24 -0.0 0.0019531 /end CHARACTERISTIC
/begin CHARACTERISTIC sg_cal_impl.Integrator_gainval "" VALUE 0x00229060 Scalar_FLOAT64_IEEE 0 sg_CM_double -1.7E+308 1.7E+308 /end CHARACTERISTIC
/begin CHARACTERISTIC sg_cal_impl.Integrator_gainval_f "" VALUE 0x00229070 Scalar_FLOAT64_IEEE 0 sg_CM_double -1.7E+308 1.7E+308 /end CHARACTERISTIC
/begin CHARACTERISTIC sg_cal_impl.PID1_I "" VALUE 0x00229020 Scalar_FLOAT64_IEEE 0 sg_CM_double -1.7E+308 1.7E+308 /end CHARACTERISTIC
/begin CHARACTERISTIC sg_cal_impl.PID1_InitialConditionForIntegra "" VALUE 0x00229030 Scalar_FLOAT64_IEEE 0 sg_CM_double -1.7E+308 1.7E+308 /end CHARACTERISTIC
/begin CHARACTERISTIC sg_cal_impl.PID1_P "" VALUE 0x00229040 Scalar_FLOAT64_IEEE 0 sg_CM_double -1.7E+308 1.7E+308 /end CHARACTERISTIC
/begin CHARACTERISTIC sg_cal_impl.PID2_I "" VALUE 0x00229028 Scalar_FLOAT64_IEEE 0 sg_CM_double -1.7E+308 1.7E+308 /end CHARACTERISTIC
/begin CHARACTERISTIC sg_cal_impl.PID2_InitialConditionForIntegra "" VALUE 0x00229038 Scalar_FLOAT64_IEEE 0 sg_CM_double -1.7E+308 1.7E+308 /end CHARACTERISTIC
/begin CHARACTERISTIC sg_cal_impl.PID2_P "" VALUE 0x00229048 Scalar_FLOAT64_IEEE 0 sg_CM_double -1.7E+308 1.7E+308 /end CHARACTERISTIC
/begin CHARACTERISTIC sg_cal_impl.Saturation2_LowerSat "" VALUE 0x00229080 Scalar_FLOAT32_IEEE 0 sg_CM_single -3.4E+38 3.4E+38 /end CHARACTERISTIC
/begin CHARACTERISTIC sg_cal_impl.Saturation2_UpperSat "" VALUE 0x0022907C Scalar_FLOAT32_IEEE 0 sg_CM_single -3.4E+38 3.4E+38 /end CHARACTERISTIC
/begin CHARACTERISTIC sg_cal_impl.Saturation3_LowerSat "" VALUE 0x00229088 Scalar_FLOAT32_IEEE 0 sg_CM_single -3.4E+38 3.4E+38 /end CHARACTERISTIC
/begin CHARACTERISTIC sg_cal_impl.Saturation3_UpperSat "" VALUE 0x00229084 Scalar_FLOAT32_IEEE 0 sg_CM_single -3.4E+38 3.4E+38 /end CHARACTERISTIC
/begin CHARACTERISTIC sg_cal_impl.UDPReceive1_fmAddress "" VAL_BLK 0x002290A0 Scalar_UBYTE 0 sg_CM_uint8 0 255 MATRIX_DIM 4 1 /end CHARACTERISTIC
/begin CHARACTERISTIC sg_cal_impl.UDPReceive_fmAddress "" VAL_BLK 0x002290A8 Scalar_UBYTE 0 sg_CM_uint8 0 255 MATRIX_DIM 4 1 /end CHARACTERISTIC
/begin CHARACTERISTIC sg_cal_impl.UDPSend_toAddress "" VAL_BLK 0x002290A4 Scalar_UBYTE 0 sg_CM_uint8 0 255 MATRIX_DIM 4 1 /end CHARACTERISTIC
/begin CHARACTERISTIC sg_cal_impl.UDPSend_toPort "" VALUE 0x0022909E Scalar_UWORD 0 sg_CM_uint16 0 65535 /end CHARACTERISTIC
/begin CHARACTERISTIC sg_cal_impl.Zero_Value "" VALUE 0x00229078 Scalar_FLOAT32_IEEE 0 sg_CM_single -3.4E+38 3.4E+38 /end CHARACTERISTIC
/begin MEASUREMENT sg_B.Add "" ULONG sg_CM_uint32 0 0 0 2147483646 ECU_ADDRESS 0x0022969C /end MEASUREMENT
/begin MEASUREMENT sg_B.BytePacking "" UBYTE sg_CM_uint8 0 0 0 255 LAYOUT COLUMN_DIR MATRIX_DIM 136 ECU_ADDRESS 0x00229856 /end MEASUREMENT
/begin MEASUREMENT sg_B.ByteUnpacking_o1 "" ULONG sg_CM_uint32 0 0 0 2147483646 ECU_ADDRESS 0x002296A0 /end MEASUREMENT
/begin MEASUREMENT sg_B.ByteUnpacking_o10 "" FLOAT32_IEEE sg_CM_single 0 0 -3.4E+38 3.4E+38 LAYOUT COLUMN_DIR MATRIX_DIM 6 ECU_ADDRESS 0x00229758 /end MEASUREMENT
/begin MEASUREMENT sg_B.ByteUnpacking_o11 "" FLOAT32_IEEE sg_CM_single 0 0 -3.4E+38 3.4E+38 LAYOUT COLUMN_DIR MATRIX_DIM 6 ECU_ADDRESS 0x00229770 /end MEASUREMENT
/begin MEASUREMENT sg_B.ByteUnpacking_o12 "" FLOAT32_IEEE sg_CM_single 0 0 -3.4E+38 3.4E+38 LAYOUT COLUMN_DIR MATRIX_DIM 6 ECU_ADDRESS 0x00229788 /end MEASUREMENT
/begin MEASUREMENT sg_B.ByteUnpacking_o13 "" FLOAT32_IEEE sg_CM_single 0 0 -3.4E+38 3.4E+38 LAYOUT COLUMN_DIR MATRIX_DIM 6 ECU_ADDRESS 0x002297A0 /end MEASUREMENT
/begin MEASUREMENT sg_B.ByteUnpacking_o14 "" FLOAT32_IEEE sg_CM_single 0 0 -3.4E+38 3.4E+38 LAYOUT COLUMN_DIR MATRIX_DIM 6 ECU_ADDRESS 0x002297B8 /end MEASUREMENT
/begin MEASUREMENT sg_B.ByteUnpacking_o15 "" FLOAT32_IEEE sg_CM_single 0 0 -3.4E+38 3.4E+38 LAYOUT COLUMN_DIR MATRIX_DIM 6 ECU_ADDRESS 0x002297D0 /end MEASUREMENT
/begin MEASUREMENT sg_B.ByteUnpacking_o16 "" FLOAT32_IEEE sg_CM_single 0 0 -3.4E+38 3.4E+38 LAYOUT COLUMN_DIR MATRIX_DIM 6 ECU_ADDRESS 0x002297E8 /end MEASUREMENT
/begin MEASUREMENT sg_B.ByteUnpacking_o2 "" FLOAT32_IEEE sg_CM_single 0 0 -3.4E+38 3.4E+38 ECU_ADDRESS 0x002296D4 /end MEASUREMENT
/begin MEASUREMENT sg_B.ByteUnpacking_o3 "" FLOAT32_IEEE sg_CM_single 0 0 -3.4E+38 3.4E+38 LAYOUT COLUMN_DIR MATRIX_DIM 6 ECU_ADDRESS 0x002296D8 /end MEASUREMENT
/begin MEASUREMENT sg_B.ByteUnpacking_o4 "" FLOAT32_IEEE sg_CM_single 0 0 -3.4E+38 3.4E+38 LAYOUT COLUMN_DIR MATRIX_DIM 6 ECU_ADDRESS 0x002296F0 /end MEASUREMENT
/begin MEASUREMENT sg_B.ByteUnpacking_o5 "" FLOAT32_IEEE sg_CM_single 0 0 -3.4E+38 3.4E+38 ECU_ADDRESS 0x00229708 /end MEASUREMENT
/begin MEASUREMENT sg_B.ByteUnpacking_o6 "" FLOAT32_IEEE sg_CM_single 0 0 -3.4E+38 3.4E+38 ECU_ADDRESS 0x0022970C /end MEASUREMENT
/begin MEASUREMENT sg_B.ByteUnpacking_o7 "" FLOAT32_IEEE sg_CM_single 0 0 -3.4E+38 3.4E+38 LAYOUT COLUMN_DIR MATRIX_DIM 6 ECU_ADDRESS 0x00229710 /end MEASUREMENT
/begin MEASUREMENT sg_B.ByteUnpacking_o8 "" FLOAT32_IEEE sg_CM_single 0 0 -3.4E+38 3.4E+38 LAYOUT COLUMN_DIR MATRIX_DIM 6 ECU_ADDRESS 0x00229728 /end MEASUREMENT
/begin MEASUREMENT sg_B.ByteUnpacking_o9 "" FLOAT32_IEEE sg_CM_single 0 0 -3.4E+38 3.4E+38 LAYOUT COLUMN_DIR MATRIX_DIM 6 ECU_ADDRESS 0x00229740 /end MEASUREMENT
/begin MEASUREMENT sg_B.Byte_Unpacking_o2 "" UBYTE sg_CM_uint8 0 0 0 255 ECU_ADDRESS 0x00229855 /end MEASUREMENT
/begin MEASUREMENT sg_B.CastToSingle "" FLOAT32_IEEE sg_CM_single 0 0 -3.4E+38 3.4E+38 MATRIX_DIM 1 1 ECU_ADDRESS 0x002296C0 /end MEASUREMENT
/begin MEASUREMENT sg_B.CastToSingle1 "" FLOAT32_IEEE sg_CM_single 0 0 -3.4E+38 3.4E+38 MATRIX_DIM 1 1 ECU_ADDRESS 0x002296B4 /end MEASUREMENT
/begin MEASUREMENT sg_B.CastToSingle2 "" FLOAT32_IEEE sg_CM_single 0 0 -3.4E+38 3.4E+38 ECU_ADDRESS 0x00229800 /end MEASUREMENT
/begin MEASUREMENT sg_B.CastToSingle3 "" FLOAT32_IEEE sg_CM_single 0 0 -3.4E+38 3.4E+38 ECU_ADDRESS 0x00229804 /end MEASUREMENT
/begin MEASUREMENT sg_B.Clock "" FLOAT64_IEEE sg_CM_double 0 0 -1.7E+308 1.7E+308 ECU_ADDRESS 0x00229628 /end MEASUREMENT
/begin MEASUREMENT sg_B.Delay "" ULONG sg_CM_uint32 0 0 0 2147483646 ECU_ADDRESS 0x00229698 /end MEASUREMENT
/begin MEASUREMENT sg_B.Eul_XYZ "" FLOAT32_IEEE sg_CM_single 0 0 -3.4E+38 3.4E+38 LAYOUT COLUMN_DIR MATRIX_DIM 3 1 ECU_ADDRESS 0x00229808 /end MEASUREMENT
/begin MEASUREMENT sg_B.Gain "" SLONG sg_CM_sfix32_En24 0 0 -128.0 128 LAYOUT COLUMN_DIR MATRIX_DIM 6 ECU_ADDRESS 0x00229814 /end MEASUREMENT
/begin MEASUREMENT sg_B.IntegralGain "" FLOAT64_IEEE sg_CM_double 0 0 -1.7E+308 1.7E+308 MATRIX_DIM 1 1 ECU_ADDRESS 0x00229660 /end MEASUREMENT
/begin MEASUREMENT sg_B.IntegralGain_l "" FLOAT64_IEEE sg_CM_double 0 0 -1.7E+308 1.7E+308 MATRIX_DIM 1 1 ECU_ADDRESS 0x00229668 /end MEASUREMENT
/begin MEASUREMENT sg_B.Integrator "" FLOAT64_IEEE sg_CM_double 0 0 -1.7E+308 1.7E+308 MATRIX_DIM 1 1 ECU_ADDRESS 0x00229618 /end MEASUREMENT
/begin MEASUREMENT sg_B.Integrator_h "" FLOAT64_IEEE sg_CM_double 0 0 -1.7E+308 1.7E+308 MATRIX_DIM 1 1 ECU_ADDRESS 0x00229640 /end MEASUREMENT
/begin MEASUREMENT sg_B.MultiportSwitch "" FLOAT32_IEEE sg_CM_single 0 0 -3.4E+38 3.4E+38 MATRIX_DIM 1 1 ECU_ADDRESS 0x002296C4 /end MEASUREMENT
/begin MEASUREMENT sg_B.MultiportSwitch1 "" FLOAT32_IEEE sg_CM_single 0 0 -3.4E+38 3.4E+38 MATRIX_DIM 1 1 ECU_ADDRESS 0x002296B8 /end MEASUREMENT
/begin MEASUREMENT sg_B.ProportionalGain "" FLOAT64_IEEE sg_CM_double 0 0 -1.7E+308 1.7E+308 MATRIX_DIM 1 1 ECU_ADDRESS 0x00229610 /end MEASUREMENT
/begin MEASUREMENT sg_B.ProportionalGain_a "" FLOAT64_IEEE sg_CM_double 0 0 -1.7E+308 1.7E+308 MATRIX_DIM 1 1 ECU_ADDRESS 0x00229638 /end MEASUREMENT
/begin MEASUREMENT sg_B.RP_measure "" FLOAT64_IEEE sg_CM_double 0 0 -1.7E+308 1.7E+308 LAYOUT COLUMN_DIR MATRIX_DIM 2 ECU_ADDRESS 0x00229650 /end MEASUREMENT
/begin MEASUREMENT sg_B.Saturation2 "" FLOAT32_IEEE sg_CM_single 0 0 -3.4E+38 3.4E+38 MATRIX_DIM 1 1 ECU_ADDRESS 0x002296BC /end MEASUREMENT
/begin MEASUREMENT sg_B.Saturation3 "" FLOAT32_IEEE sg_CM_single 0 0 -3.4E+38 3.4E+38 MATRIX_DIM 1 1 ECU_ADDRESS 0x002296C8 /end MEASUREMENT
/begin MEASUREMENT sg_B.Sum "" FLOAT64_IEEE sg_CM_double 0 0 -1.7E+308 1.7E+308 MATRIX_DIM 1 1 ECU_ADDRESS 0x00229620 /end MEASUREMENT
/begin MEASUREMENT sg_B.Sum1 "" FLOAT64_IEEE sg_CM_double 0 0 -1.7E+308 1.7E+308 MATRIX_DIM 1 1 ECU_ADDRESS 0x00229608 /end MEASUREMENT
/begin MEASUREMENT sg_B.Sum2 "" FLOAT64_IEEE sg_CM_double 0 0 -1.7E+308 1.7E+308 MATRIX_DIM 1 1 ECU_ADDRESS 0x00229630 /end MEASUREMENT
/begin MEASUREMENT sg_B.Sum_j "" FLOAT64_IEEE sg_CM_double 0 0 -1.7E+308 1.7E+308 MATRIX_DIM 1 1 ECU_ADDRESS 0x00229648 /end MEASUREMENT
/begin MEASUREMENT sg_B.UDPReceive1_o1 "" UBYTE sg_CM_uint8 0 0 0 255 LAYOUT COLUMN_DIR MATRIX_DIM 29 ECU_ADDRESS 0x00229838 /end MEASUREMENT
/begin MEASUREMENT sg_B.UDPReceive1_o2 "" FLOAT64_IEEE sg_CM_double 0 0 -1.7E+308 1.7E+308 ECU_ADDRESS 0x00229600 /end MEASUREMENT
/begin MEASUREMENT sg_B.UDPReceive_o1 "" UBYTE sg_CM_uint8 0 0 0 255 LAYOUT COLUMN_DIR MATRIX_DIM 304 ECU_ADDRESS 0x002298DE /end MEASUREMENT
/begin MEASUREMENT sg_B.UDPReceive_o2 "" FLOAT64_IEEE sg_CM_double 0 0 -1.7E+308 1.7E+308 ECU_ADDRESS 0x00229670 /end MEASUREMENT
/begin MEASUREMENT sg_B.UDP_IMU "" FLOAT32_IEEE sg_CM_single 0 0 -3.4E+38 3.4E+38 LAYOUT COLUMN_DIR MATRIX_DIM 4 ECU_ADDRESS 0x002296A4 /end MEASUREMENT
/begin MEASUREMENT sg_B.UDP_flag "" UBYTE sg_CM_logical 0 0 0 1 ECU_ADDRESS 0x00229A0E /end MEASUREMENT
/begin MEASUREMENT sg_B.UDP_pos "" SWORD sg_CM_int16 0 0 -32768 32767 LAYOUT COLUMN_DIR MATRIX_DIM 6 ECU_ADDRESS 0x0022982C /end MEASUREMENT
/begin MEASUREMENT sg_B.Wire_Angles "" FLOAT64_IEEE sg_CM_double 0 0 -1.7E+308 1.7E+308 LAYOUT COLUMN_DIR MATRIX_DIM 2 1 ECU_ADDRESS 0x00229688 /end MEASUREMENT
/begin MEASUREMENT sg_B.comau_u "" FLOAT32_IEEE sg_CM_single 0 0 -3.4E+38 3.4E+38 LAYOUT COLUMN_DIR MATRIX_DIM 2 ECU_ADDRESS 0x002296CC /end MEASUREMENT
/begin MEASUREMENT sg_B.y "" FLOAT64_IEEE sg_CM_double 0 0 -1.7E+308 1.7E+308 ECU_ADDRESS 0x00229678 /end MEASUREMENT
/begin MEASUREMENT sg_B.y_d "" FLOAT64_IEEE sg_CM_double 0 0 -1.7E+308 1.7E+308 ECU_ADDRESS 0x00229680 /end MEASUREMENT
/begin MEASUREMENT sg_DW.Delay_DSTATE "" ULONG sg_CM_uint32 0 0 0 2147483646 ECU_ADDRESS 0x00229428 /end MEASUREMENT
/begin MEASUREMENT sg_DW.Integrator_DSTATE "" FLOAT64_IEEE sg_CM_double 0 0 -1.7E+308 1.7E+308 ECU_ADDRESS 0x00229380 /end MEASUREMENT
/begin MEASUREMENT sg_DW.Integrator_DSTATE_a "" FLOAT64_IEEE sg_CM_double 0 0 -1.7E+308 1.7E+308 ECU_ADDRESS 0x00229388 /end MEASUREMENT
/begin MEASUREMENT sg_DW.profile_started "" UBYTE sg_CM_logical 0 0 0 1 ECU_ADDRESS 0x002295E5 /end MEASUREMENT
/begin MEASUREMENT sg_DW.profile_triggered "" UBYTE sg_CM_logical 0 0 0 1 ECU_ADDRESS 0x002295E4 /end MEASUREMENT
/begin MEASUREMENT sg_DW.t_command_received "" FLOAT64_IEEE sg_CM_double 0 0 -1.7E+308 1.7E+308 ECU_ADDRESS 0x00229390 /end MEASUREMENT
/begin MEASUREMENT sg_DW.t_start "" FLOAT64_IEEE sg_CM_double 0 0 -1.7E+308 1.7E+308 ECU_ADDRESS 0x00229398 /end MEASUREMENT
/begin MEASUREMENT sg_U.Input1 "" ULONG sg_CM_uint32 0 0 0 2147483646 LAYOUT COLUMN_DIR MATRIX_DIM 3 ECU_ADDRESS 0x00229300 /end MEASUREMENT
/begin MEASUREMENT sg_U.Input2 "" FLOAT32_IEEE sg_CM_single 0 0 -3.4E+38 3.4E+38 LAYOUT COLUMN_DIR MATRIX_DIM 24 ECU_ADDRESS 0x0022930C /end MEASUREMENT
/begin MEASUREMENT sg_U.Input3 "" FLOAT32_IEEE sg_CM_single 0 0 -3.4E+38 3.4E+38 LAYOUT COLUMN_DIR MATRIX_DIM 3 ECU_ADDRESS 0x0022936C /end MEASUREMENT
/begin COMPU_METHOD sg_CM_double "" IDENTICAL "%15.10" "" /end COMPU_METHOD
/begin COMPU_METHOD sg_CM_int16 "" IDENTICAL "%5.0" "" /end COMPU_METHOD
/begin COMPU_METHOD sg_CM_logical "" IDENTICAL "%1.0" "" /end COMPU_METHOD
/begin COMPU_METHOD sg_CM_sfix16_En24 "" LINEAR "%14.16" "" COEFFS_LINEAR 5.96046e-08 0.000000 /end COMPU_METHOD
/begin COMPU_METHOD sg_CM_sfix32_En24 "" LINEAR "%19.16" "" COEFFS_LINEAR 5.96046e-08 0.000000 /end COMPU_METHOD
/begin COMPU_METHOD sg_CM_single "" IDENTICAL "%8.6" "" /end COMPU_METHOD
/begin COMPU_METHOD sg_CM_uint16 "" IDENTICAL "%5.0" "" /end COMPU_METHOD
/begin COMPU_METHOD sg_CM_uint32 "" IDENTICAL "%10.0" "" /end COMPU_METHOD
/begin COMPU_METHOD sg_CM_uint8 "" IDENTICAL "%3.0" "" /end COMPU_METHOD
/begin RECORD_LAYOUT Scalar_BOOLEAN FNC_VALUES 1 UBYTE COLUMN_DIR DIRECT /end RECORD_LAYOUT
/begin RECORD_LAYOUT Scalar_FLOAT32_IEEE FNC_VALUES 1 FLOAT32_IEEE COLUMN_DIR DIRECT /end RECORD_LAYOUT
/begin RECORD_LAYOUT Scalar_FLOAT64_IEEE FNC_VALUES 1 FLOAT64_IEEE COLUMN_DIR DIRECT /end RECORD_LAYOUT
/begin RECORD_LAYOUT Scalar_SLONG FNC_VALUES 1 SLONG COLUMN_DIR DIRECT /end RECORD_LAYOUT
/begin RECORD_LAYOUT Scalar_SWORD FNC_VALUES 1 SWORD COLUMN_DIR DIRECT /end RECORD_LAYOUT
/begin RECORD_LAYOUT Scalar_UBYTE FNC_VALUES 1 UBYTE COLUMN_DIR DIRECT /end RECORD_LAYOUT
/begin RECORD_LAYOUT Scalar_ULONG FNC_VALUES 1 ULONG COLUMN_DIR DIRECT /end RECORD_LAYOUT
/begin RECORD_LAYOUT Scalar_UWORD FNC_VALUES 1 UWORD COLUMN_DIR DIRECT /end RECORD_LAYOUT
/begin GROUP sg "sg" ROOT /begin SUB_GROUP sg_BytePackingBlock sg_ByteUnpackBlock sg_PID1 sg_PID2 /end SUB_GROUP
 /begin REF_CHARACTERISTIC sg_cal_impl.Constant1_Value sg_cal_impl.Constant2_Value sg_cal_impl.Constant_Value sg_cal_impl.Gain_Gain sg_cal_impl.Saturation2_LowerSat sg_cal_impl.Saturation2_UpperSat sg_cal_impl.Saturation3_LowerSat sg_cal_impl.Saturation3_UpperSat sg_cal_impl.UDPReceive1_fmAddress sg_cal_impl.UDPReceive_fmAddress sg_cal_impl.UDPSend_toAddress sg_cal_impl.UDPSend_toPort sg_cal_impl.Zero_Value /end REF_CHARACTERISTIC
 /begin REF_MEASUREMENT sg_B.BytePacking sg_B.Byte_Unpacking_o2 sg_B.CastToSingle sg_B.CastToSingle1 sg_B.CastToSingle2 sg_B.CastToSingle3 sg_B.Clock sg_B.Eul_XYZ sg_B.Gain sg_B.MultiportSwitch sg_B.MultiportSwitch1 sg_B.RP_measure sg_B.Saturation2 sg_B.Saturation3 sg_B.Sum sg_B.Sum1 sg_B.Sum2 sg_B.Sum_j sg_B.UDPReceive1_o1 sg_B.UDPReceive1_o2 sg_B.UDPReceive_o1 sg_B.UDPReceive_o2 sg_B.UDP_IMU sg_B.UDP_flag sg_B.UDP_pos sg_B.Wire_Angles sg_B.comau_u sg_B.y sg_B.y_d sg_ConstB.Width sg_DW.UDPReceive1_PWORK sg_DW.UDPReceive_PWORK sg_DW.UDPSend_PWORK sg_DW.profile_started sg_DW.profile_triggered sg_DW.t_command_received sg_DW.t_start sg_U.Input1 sg_U.Input2 sg_U.Input3 /end REF_MEASUREMENT
/end GROUP
/begin GROUP sg_BytePackingBlock "sg/BytePackingBlock"
 /begin REF_CHARACTERISTIC sg_cal_impl.Constant1_Value_o sg_cal_impl.Constant2_Value_b sg_cal_impl.Constant_Value_i sg_cal_impl.Delay_InitialCondition /end REF_CHARACTERISTIC
 /begin REF_MEASUREMENT sg_B.Add sg_B.BytePacking sg_B.Delay sg_B.Saturation2 sg_B.Saturation3 sg_DW.Delay_DSTATE sg_U.Input1 sg_U.Input2 sg_U.Input3 /end REF_MEASUREMENT
/end GROUP
/begin GROUP sg_ByteUnpackBlock "sg/ByteUnpackBlock"
 /begin REF_MEASUREMENT sg_B.ByteUnpacking_o1 sg_B.ByteUnpacking_o10 sg_B.ByteUnpacking_o11 sg_B.ByteUnpacking_o12 sg_B.ByteUnpacking_o13 sg_B.ByteUnpacking_o14 sg_B.ByteUnpacking_o15 sg_B.ByteUnpacking_o16 sg_B.ByteUnpacking_o2 sg_B.ByteUnpacking_o3 sg_B.ByteUnpacking_o4 sg_B.ByteUnpacking_o5 sg_B.ByteUnpacking_o6 sg_B.ByteUnpacking_o7 sg_B.ByteUnpacking_o8 sg_B.ByteUnpacking_o9 sg_B.UDPReceive_o1 /end REF_MEASUREMENT
/end GROUP
/begin GROUP sg_PID1 "sg/PID1"
 /begin SUB_GROUP sg_PID1_Anti_windup sg_PID1_D_Gain sg_PID1_Filter sg_PID1_Filter_ICs sg_PID1_I_Gain sg_PID1_Ideal_P_Gain sg_PID1_Ideal_P_Gain_Fdbk sg_PID1_Integrator sg_PID1_Integrator_ICs sg_PID1_N_Copy sg_PID1_N_Gain sg_PID1_PID_Compensator_Formula sg_PID1_P_Copy sg_PID1_Parallel_P_Gain sg_PID1_Reset_Signal sg_PID1_Saturation sg_PID1_Saturation_Fdbk sg_PID1_Sum /end SUB_GROUP
/end GROUP
/begin GROUP sg_PID1_I_Gain "sg/PID1/I Gain" /begin SUB_GROUP sg_PID1_I_Gain_Internal_Parameters /end SUB_GROUP /end GROUP
/begin GROUP sg_PID1_I_Gain_Internal_Parameters "sg/PID1/I Gain/Internal Parameters" /begin REF_CHARACTERISTIC sg_cal_impl.PID1_I /end REF_CHARACTERISTIC /begin REF_MEASUREMENT sg_B.IntegralGain sg_B.Sum1 /end REF_MEASUREMENT /end GROUP
/begin GROUP sg_PID1_Integrator "sg/PID1/Integrator" /begin SUB_GROUP sg_PID1_Integrator_Discrete /end SUB_GROUP /end GROUP
/begin GROUP sg_PID1_Integrator_Discrete "sg/PID1/Integrator/Discrete"
 /begin REF_CHARACTERISTIC sg_cal_impl.Integrator_gainval sg_cal_impl.PID1_InitialConditionForIntegra /end REF_CHARACTERISTIC
 /begin REF_MEASUREMENT sg_B.IntegralGain sg_B.Integrator sg_DW.Integrator_DSTATE /end REF_MEASUREMENT
/end GROUP
/begin GROUP sg_PID1_Parallel_P_Gain "sg/PID1/Parallel P Gain" /begin SUB_GROUP sg_PID1_Parallel_P_Gain_Internal_Parameters /end SUB_GROUP /end GROUP
/begin GROUP sg_PID1_Parallel_P_Gain_Internal_Parameters "sg/PID1/Parallel P Gain/Internal Parameters" /begin REF_CHARACTERISTIC sg_cal_impl.PID1_P /end REF_CHARACTERISTIC /begin REF_MEASUREMENT sg_B.ProportionalGain sg_B.Sum1 /end REF_MEASUREMENT /end GROUP
/begin GROUP sg_PID1_Sum "sg/PID1/Sum" /begin SUB_GROUP sg_PID1_Sum_Sum_PI /end SUB_GROUP /end GROUP
/begin GROUP sg_PID1_Sum_Sum_PI "sg/PID1/Sum/Sum_PI" /begin REF_MEASUREMENT sg_B.Integrator sg_B.ProportionalGain sg_B.Sum /end REF_MEASUREMENT /end GROUP
/begin GROUP sg_PID2 "sg/PID2"
 /begin SUB_GROUP sg_PID2_Anti_windup sg_PID2_D_Gain sg_PID2_Filter sg_PID2_Filter_ICs sg_PID2_I_Gain sg_PID2_Ideal_P_Gain sg_PID2_Ideal_P_Gain_Fdbk sg_PID2_Integrator sg_PID2_Integrator_ICs sg_PID2_N_Copy sg_PID2_N_Gain sg_PID2_PID_Compensator_Formula sg_PID2_P_Copy sg_PID2_Parallel_P_Gain sg_PID2_Reset_Signal sg_PID2_Saturation sg_PID2_Saturation_Fdbk sg_PID2_Sum /end SUB_GROUP
/end GROUP
/begin GROUP sg_PID2_I_Gain "sg/PID2/I Gain" /begin SUB_GROUP sg_PID2_I_Gain_Internal_Parameters /end SUB_GROUP /end GROUP
/begin GROUP sg_PID2_I_Gain_Internal_Parameters "sg/PID2/I Gain/Internal Parameters" /begin REF_CHARACTERISTIC sg_cal_impl.PID2_I /end REF_CHARACTERISTIC /begin REF_MEASUREMENT sg_B.IntegralGain_l sg_B.Sum2 /end REF_MEASUREMENT /end GROUP
/begin GROUP sg_PID2_Integrator "sg/PID2/Integrator" /begin SUB_GROUP sg_PID2_Integrator_Discrete /end SUB_GROUP /end GROUP
/begin GROUP sg_PID2_Integrator_Discrete "sg/PID2/Integrator/Discrete"
 /begin REF_CHARACTERISTIC sg_cal_impl.Integrator_gainval_f sg_cal_impl.PID2_InitialConditionForIntegra /end REF_CHARACTERISTIC
 /begin REF_MEASUREMENT sg_B.IntegralGain_l sg_B.Integrator_h sg_DW.Integrator_DSTATE_a /end REF_MEASUREMENT
/end GROUP
/begin GROUP sg_PID2_Parallel_P_Gain "sg/PID2/Parallel P Gain" /begin SUB_GROUP sg_PID2_Parallel_P_Gain_Internal_Parameters /end SUB_GROUP /end GROUP
/begin GROUP sg_PID2_Parallel_P_Gain_Internal_Parameters "sg/PID2/Parallel P Gain/Internal Parameters" /begin REF_CHARACTERISTIC sg_cal_impl.PID2_P /end REF_CHARACTERISTIC /begin REF_MEASUREMENT sg_B.ProportionalGain_a sg_B.Sum2 /end REF_MEASUREMENT /end GROUP
/begin GROUP sg_PID2_Sum "sg/PID2/Sum" /begin SUB_GROUP sg_PID2_Sum_Sum_PI /end SUB_GROUP /end GROUP
/begin GROUP sg_PID2_Sum_Sum_PI "sg/PID2/Sum/Sum_PI" /begin REF_MEASUREMENT sg_B.Integrator_h sg_B.ProportionalGain_a sg_B.Sum_j /end REF_MEASUREMENT /end GROUP
/end MODULE
/end PROJECT
